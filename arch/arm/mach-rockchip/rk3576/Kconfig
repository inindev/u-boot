## arch/arm/mach-rockchip/rk3576/Kconfig
```kconfig
if ROCKCHIP_RK3576

config TARGET_ARMSOM_SIGE5
	bool "ArmSoM Sige5 with Rockchip RK3576"
	help
	  Enable support for the ArmSoM Sige5, powered by the 8nm Rockchip RK3576
	  SoC with a quad-core Cortex-A72 @ 2.2GHz, quad-core Cortex-A53 @ 1.8GHz,
	  Mali-G52 MC3 GPU, and 6 TOPS NPU. Supports up to 16GB LPDDR4X, dual
	  Gigabit Ethernet, WiFi 6, Bluetooth 5.0, and 4K HDMI/MIPI DSI outputs.

config TARGET_OMNI3576_RK3576
	bool "Luckfox Omni3576 Carrier Board with Core3576 Module"
	help
	  Enable support for the Luckfox Omni3576 carrier board, paired with the
	  Core3576 compute module. The Core3576 features the Rockchip RK3576 SoC,
	  with a quad-core Arm Cortex-A72 at 2.2GHz, quad-core Arm Cortex-A53 at
	  2.0GHz, an Arm Mali-G52 MC3 GPU, and a 6 TOPS NPU.

config TARGET_ROC_PC_RK3576
	bool "Firefly ROC-RK3576-PC"
	help
	  ROC-RK3576-PC is a single board computer from Firefly
	  using the Rockchip RK3576.

config ROCKCHIP_BOOT_MODE_REG
	default 0x26024040

config ROCKCHIP_STIMER_BASE
	default 0x27400000

config SYS_SOC
	default "rk3576"

source board/luckfox/omni3576-rk3576/Kconfig
source board/firefly/roc-pc-rk3576/Kconfig

config SYS_CONFIG_NAME
	default "rk3576_common"

endif
```

## board/armsom/sige5-rk3576/Kconfig
```kconfig
if TARGET_SIGE5_RK3576

config SYS_BOARD
	default "sige5-rk3576"

config SYS_VENDOR
	default "armsom"

config SYS_CONFIG_NAME
	default "sige5-rk3576"

endif
```

## board/luckfox/omni3576-rk3576/Kconfig
```kconfig
if TARGET_OMNI3576_RK3576

config SYS_BOARD
	default "omni3576-rk3576"

config SYS_VENDOR
	default "luckfox"

config SYS_CONFIG_NAME
	default "omni3576-rk3576"

endif
```

## board/resideo/rth9580wf01/Kconfig
```kconfig
if TARGET_RTH9580WF01

config SYS_BOARD
	default "rth9580wf01"

config SYS_VENDOR
	default "resideo"

config SYS_CONFIG_NAME
	default "rth9580wf01"

endif
```

## configs/rth9580wf01_spiflash_defconfig
```kconfig
CONFIG_ARM=y
CONFIG_ARCH_AT91=y
CONFIG_SYS_TEXT_BASE=0x20f50000
CONFIG_TARGET_RTH9580WF01=y
CONFIG_SYS_MALLOC_F_LEN=0x2000
CONFIG_NR_DRAM_BANKS=1
CONFIG_ENV_SIZE=0x4000
CONFIG_ENV_OFFSET=0x8000
CONFIG_ENV_SECT_SIZE=0x1000
CONFIG_DM_GPIO=y
CONFIG_DEBUG_UART_BOARD_INIT=y
CONFIG_DEBUG_UART_BASE=0xfffff200
CONFIG_DEBUG_UART_CLOCK=132000000
CONFIG_ENV_OFFSET_REDUND=0xc000
CONFIG_DEFAULT_DEVICE_TREE="rth9580wf01"
CONFIG_DEBUG_UART=y
CONFIG_FIT=y
CONFIG_SPI_BOOT=y
# CONFIG_CONSOLE_MUX is not set
CONFIG_SYS_CONSOLE_IS_IN_ENV=y
CONFIG_LOG=y
CONFIG_HUSH_PARSER=y
CONFIG_SYS_PROMPT="uboot> "
CONFIG_CMD_BOOTZ=y
# CONFIG_BOOTM_NETBSD is not set
# CONFIG_BOOTM_PLAN9 is not set
# CONFIG_BOOTM_RTEMS is not set
# CONFIG_BOOTM_VXWORKS is not set
# CONFIG_CMD_ELF is not set
CONFIG_CMD_MEMINFO=y
CONFIG_CMD_DM=y
# CONFIG_CMD_FLASH is not set
CONFIG_CMD_GPIO=y
CONFIG_CMD_MTD=y
CONFIG_CMD_SDRAM=y
# CONFIG_CMD_SETEXPR is not set
CONFIG_CMD_SQUASHFS=y
CONFIG_CMD_JFFS2=y
CONFIG_CMD_MTDPARTS=y
CONFIG_MTDIDS_DEFAULT="nor0=spi-flash.0"
CONFIG_MTDPARTS_DEFAULT="mtdparts=spi-flash.0:32k(spl),16k(uenv1),16k(uenv2),704k(uboot),4m(kernel),4m(rootfs),-(data)"
# CONFIG_PARTITIONS is not set
CONFIG_OF_CONTROL=y
CONFIG_ENV_IS_IN_SPI_FLASH=y
CONFIG_USE_ENV_SPI_BUS=y
CONFIG_ENV_SPI_BUS=0
CONFIG_USE_ENV_SPI_CS=y
CONFIG_ENV_SPI_CS=0
CONFIG_USE_ENV_SPI_MAX_HZ=y
CONFIG_ENV_SPI_MAX_HZ=50000000
CONFIG_USE_ENV_SPI_MODE=y
CONFIG_ENV_SPI_MODE=0x0
CONFIG_SYS_REDUNDAND_ENVIRONMENT=y
CONFIG_SYS_RELOC_GD_ENV_ADDR=y
# CONFIG_NET is not set
CONFIG_DM=y
CONFIG_CLK=y
CONFIG_CLK_AT91=y
CONFIG_AT91_GPIO=y
# CONFIG_MMC is not set
CONFIG_MTD=y
CONFIG_DM_MTD=y
CONFIG_DM_SPI_FLASH=y
CONFIG_SF_DEFAULT_MODE=0
CONFIG_SF_DEFAULT_SPEED=50000000
CONFIG_SPI_FLASH_ISSI=y
CONFIG_SPI_FLASH_WINBOND=y
CONFIG_SPI_FLASH_MTD=y
CONFIG_PINCTRL=y
CONFIG_PINCTRL_AT91=y
CONFIG_DM_SERIAL=y
CONFIG_ATMEL_USART=y
CONFIG_SPI=y
CONFIG_DM_SPI=y
CONFIG_TIMER=y
CONFIG_ATMEL_PIT_TIMER=y
CONFIG_DM_VIDEO=y
# CONFIG_VIDEO_BPP8 is not set
# CONFIG_VIDEO_BPP32 is not set
CONFIG_CONSOLE_ROTATION=y
CONFIG_ATMEL_HLCD=y
CONFIG_LZMA=y
```
